## arch/Kconfig.rej
```kconfig
diff a/arch/Kconfig b/arch/Kconfig	(rejected hunks)
@@ -1191,6 +1191,7 @@ config ARCH_HAS_ELFCORE_COMPAT
 	bool
 
 source "kernel/gcov/Kconfig"
+source "kernel/pgo/Kconfig"
 
 source "scripts/gcc-plugins/Kconfig"
 
```
